## arch/arm64/Kconfig.htc
```kconfig
config HTC_DEBUG_RTB
	default y
	depends on HTC_DEBUG && MSM_RTB
	bool "HTC style rtb debug features"
	help
	  Say Y here if you want the HTC style rtb debug features

config HTC_FEATURES_SSR
       bool "HTC style ssr features"
       depends on MSM_SUBSYSTEM_RESTART
       default n
       help
         Say Y here if you want the HTC style ssr features

config HTC_FEATURES_SSR_MODEM_ENABLE
       bool "HTC style modem ssr features"
       depends on HTC_FEATURES_SSR
       default n
       help
         Say Y here if you want the HTC style for modem ssr features

config HTC_FEATURES_SSR_WCNSS_ENABLE
       bool "HTC style wcnss ssr features"
       depends on HTC_FEATURES_SSR
       default n
       help

config HTC_DEBUG_SSR
       bool "HTC style subsys restart debug features"
       depends on HTC_DEBUG && MSM_SUBSYSTEM_RESTART
       help
         Say Y here if you want the HTC style subsys restart debug features

config AUD_8x16_MI2S
       bool "HTC audio speaker with mi2s on 8x16"
       default n
       help

config AUD_MICB_INT_RBIAS_DISABLE
       bool "HTC audio not pull up on  MICB1 RBIAS setting"
       default n
       help
```

## drivers/cpumako/Kconfig.txt
```kconfig
config MAKO_HOTPLUG
        bool "Enable mako-hotplug cpu hotplug driver"
        default n
        help
          Generic Intelli-plug cpu hotplug driver for ARM SOCs
```

## drivers/htc_ril/Kconfig
```kconfig
config HTC_RADIO_SMEM
	bool "RADIO SMEM"
	default N
	---help---
	Enable to move necessary non-secure data to shared memory


config HTC_FEATURES_RIL_PCN0001_REBOOT_WITH_ERASE_EFS
       bool "Reboot with ERASE_EFS reason when SMSM_ERASE_EFS raised"
       default y
       help
         When modem met fatal,
         It will enable bit RESTART_MODE_ERASE_EFS.
         Then when device reboot, it will clean up EFS.

config HTC_DEBUG_RIL_PCN0002_DUMP_STACK
       bool "Dump call stack when modem crash"
       help
         Say Y here if you want dump call stack when modem crash

config HTC_FEATURES_RIL_PCN0003_HTC_MONITOR
	tristate "HTC_FEATURES_RIL_PCN0003_HTC_MONITOR"
	default n
	---help---
	  Come up with a way to add information of data usage in attribute file
	  for identifying the process that requested for data transmission.


config HTC_FEATURES_RIL_PCN0004_HTC_GARBAGE_FILTER
	tristate "HTC_FEATURES_RIL_PCN0004_HTC_GARBAGE_FILTER"
	default n
	depends on MSM_SMD
	---help---
	  Garbage Filter of TCP

config HTC_DEBUG_RIL_PCN0005_HTC_DUMP_SMSM_LOG
	tristate "HTC_DEBUG_RIL_PCN0005_HTC_DUMP_SMSM_LOG"
	default n
	depends on MSM_SMD
	---help---
	  Dump SMSM log message

config HTC_DEBUG_RIL_PCN0006_HTC_DUMP_BAM_DMUX_LOG
	tristate "HTC_DEBUG_RIL_PCN0006_HTC_DUMP_BAM_DMUX_LOG"
	default n
	depends on MSM_BAM_DMUX
	---help---
	  Dump BAM DMUX log message

config HTC_FEATURES_RIL_PCN0007_FINAL_EFS_SYNC
	tristate "HTC_DEBUG_RIL_PCN0007_FINAL_EFS_SYNC"
	default y
	---help---
	  Trigger modem EFS sync when device reboot

config HTC_FEATURES_RIL_PCN0008_ENLARGE_RADIO_BUFFER
	tristate "HTC_FEATURES_RIL_PCN0008_ENLARGE_RADIO_BUFFER"
	default n
	---help---
	  enlarge radio log buffer.
```
