/* Copyright (c) 2013, The Linux Foundation. All rights reserved.
 *
 * This program is free software; you can redistribute it and/or modify
 * it under the terms of the GNU General Public License version 2 and
 * only version 2 as published by the Free Software Foundation.
 *
 * This program is distributed in the hope that it will be useful,
 * but WITHOUT ANY WARRANTY; without even the implied warranty of
 * MERCHANTABILITY or FITNESS FOR A PARTICULAR PURPOSE.  See the
 * GNU General Public License for more details.
 */

qcom,m8ql-id1-batterydata {
	qcom,fcc-mah = <2840>;
	qcom,batt-id-kohm = <33>;
	htc,voltage_max = <4400>;
	htc,capacity = <2840>;
	htc,batt_id = <1>;
	htc,id_raw_min = <201>;
	htc,id_raw_max = <550>;
	htc,type = <1>;
	htc,model_name = "ICP326493A1";
};
