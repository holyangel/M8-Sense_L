	qcom,GLU-unknown-id-batterydata {
	qcom,fcc-mah = <3200>;
	qcom,default-rbatt-mohm = <250>;
	qcom,rbatt-capacitive-mohm = <0>;
	qcom,flat-ocv-threshold-uv = <3800000>;
	qcom,max-voltage-uv = <4200000>;
	qcom,v-cutoff-uv = <3000000>;
	qcom,chg-term-ua = <320000>;
	qcom,batt-id-kohm = <10>;
	htc,capacity = <3200>;
	htc,batt_id = <255>;
	htc,id_raw_min = <(-1)>;
	htc,id_raw_max = <(-1)>;
	htc,type = <0>;
	htc,model_name = "UNKNOWN";

	qcom,fcc-temp-lut {
		qcom,lut-col-legend = <(-20) (-10) 0 10 20 30 40>;
		qcom,lut-data = <3060 3240 3300 3300 3310 3310 3310>;
	};

	qcom,pc-temp-ocv-lut {
		qcom,lut-col-legend = <(-20) (-10) 0 10 20 30 40>;
		qcom,lut-row-legend = <100 95 90 85 80 75 70 65 60 55 50 45 40 35 30 25 20 15 10 9 8 7 6 5 4 3 2 1 0>;
		qcom,lut-data = <4316 4315 4312 4310 4310 4300 4300>,
				<4217 4247 4258 4262 4262 4262 4262>,
				<4135 4181 4199 4203 4203 4203 4203>,
				<4068 4119 4142 4148 4148 4148 4148>,
				<3996 4065 4088 4095 4095 4095 4095>,
				<3950 3999 4033 4046 4046 4046 4046>,
				<3909 3951 3974 3992 3998 3998 3999>,
				<3872 3910 3931 3945 3953 3953 3953>,
				<3843 3873 3891 3899 3902 3902 3902>,
				<3822 3839 3857 3864 3864 3864 3864>,
				<3805 3811 3829 3837 3837 3837 3837>,
				<3790 3790 3805 3815 3815 3815 3815>,
				<3775 3775 3786 3795 3797 3797 3797>,
				<3759 3762 3771 3779 3781 3781 3782>,
				<3742 3748 3758 3765 3765 3765 3765>,
				<3721 3731 3742 3749 3749 3749 3749>,
				<3697 3710 3720 3730 3730 3730 3730>,
				<3667 3678 3698 3704 3704 3704 3704>,
				<3628 3629 3663 3682 3682 3682 3682>,
				<3617 3611 3640 3664 3664 3664 3664>,
				<3606 3593 3616 3646 3646 3646 3646>,
				<3595 3575 3593 3629 3629 3629 3629>,
				<3584 3557 3570 3611 3611 3611 3611>,
				<3573 3539 3546 3593 3593 3593 3593>,
				<3558 3522 3496 3474 3474 3474 3474>,
				<3543 3505 3447 3356 3356 3356 3356>,
				<3528 3488 3397 3237 3237 3237 3237>,
				<3512 3472 3348 3119 3119 3119 3119>,
				<3497 3455 3298 3000 3000 3000 3000>;
	};

	qcom,rbatt-sf-lut {
		qcom,lut-col-legend = <(-20) (-10) 0 10 20 30 40>;
		qcom,lut-row-legend = <100 95 90 85 80 75 70 65 60 55 50 45 40 35 30 25 20 15 10>;
		qcom,lut-data = <243 162 148 136 95 48 47>,
				<243 162 148 136 95 48 47>,
				<243 162 148 136 95 48 47>,
				<243 162 148 136 95 48 47>,
				<243 162 148 136 95 48 47>,
				<243 162 148 136 95 48 47>,
				<243 162 148 136 95 48 47>,
				<243 162 148 136 95 48 47>,
				<243 162 148 136 95 48 47>,
				<243 162 148 136 95 48 47>,
				<243 162 148 136 95 48 47>,
				<243 162 148 136 95 48 47>,
				<243 162 148 136 95 48 47>,
				<243 162 148 136 95 48 47>,
				<243 162 148 136 95 48 47>,
				<243 162 148 136 95 48 47>,
				<243 162 148 136 95 48 47>,
				<243 162 148 136 95 48 47>,
				<243 162 148 136 95 48 47>;
		};
	};
