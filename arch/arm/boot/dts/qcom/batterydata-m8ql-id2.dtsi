/* Copyright (c) 2013, The Linux Foundation. All rights reserved.
 *
 * This program is free software; you can redistribute it and/or modify
 * it under the terms of the GNU General Public License version 2 and
 * only version 2 as published by the Free Software Foundation.
 *
 * This program is distributed in the hope that it will be useful,
 * but WITHOUT ANY WARRANTY; without even the implied warranty of
 * MERCHANTABILITY or FITNESS FOR A PARTICULAR PURPOSE.  See the
 * GNU General Public License for more details.
 */

qcom,m8ql-id2-batterydata {
	qcom,fcc-mah = <2840>;
	qcom,batt-id-kohm = <10>;
	htc,voltage_max = <4400>;
	htc,capacity = <2840>;
	htc,batt_id = <2>;
	htc,id_raw_min = <50>;
	htc,id_raw_max = <200>;
	htc,type = <1>;
	htc,model_name = "B0PGE100";
};
