	qcom,GLU-id2-batterydata {
	qcom,fcc-mah = <3200>;
	qcom,default-rbatt-mohm = <250>;
	qcom,rbatt-capacitive-mohm = <0>;
	qcom,flat-ocv-threshold-uv = <3800000>;
	qcom,max-voltage-uv = <4350000>;
	qcom,v-cutoff-uv = <3000000>;
	qcom,chg-term-ua = <320000>;
	qcom,batt-id-kohm = <22>;
	qcom,qc20-ibatmax-ma = <2600>;
	qcom,qc20-ibatsafe-ma = <2600>;
	htc,capacity = <3200>;
	htc,batt_id = <2>;
	htc,id_raw_min = <246>;
	htc,id_raw_max = <510>;
	htc,type = <1>;
	htc,model_name = "BO68100";

	qcom,fcc-temp-lut {
		qcom,lut-col-legend = <(-20) (-10) 0 10 20 30 40>;
		qcom,lut-data = <3120 3120 3210 3210 3220 3220 3220>;
	};

	qcom,pc-temp-ocv-lut {
		qcom,lut-col-legend = <(-20) (-10) 0 10 20 30 40>;
		qcom,lut-row-legend = <100 95 90 85 80 75 70 65 60 55 50 45 40 35 30 25 20 15 10 9 8 7 6 5 4 3 2 1 0>;
		qcom,lut-data = <4312 4312 4312 4310 4310 4305 4305>,
				<4223 4249 4257 4258 4257 4255 4254>,
				<4153 4189 4199 4201 4201 4199 4198>,
				<4091 4132 4145 4148 4147 4146 4145>,
				<4033 4076 4092 4097 4097 4096 4095>,
				<3979 4021 4039 4048 4048 4048 4048>,
				<3932 3971 3987 3999 4003 4004 4004>,
				<3890 3927 3941 3952 3958 3962 3964>,
				<3854 3890 3901 3909 3912 3917 3920>,
				<3822 3857 3868 3873 3875 3876 3876>,
				<3794 3829 3841 3845 3846 3847 3847>,
				<3770 3804 3817 3822 3823 3824 3824>,
				<3748 3783 3797 3803 3805 3805 3805>,
				<3727 3765 3780 3787 3789 3790 3790>,
				<3706 3749 3766 3773 3773 3773 3773>,
				<3683 3730 3752 3752 3752 3747 3747>,
				<3655 3706 3732 3733 3733 3729 3729>,
				<3618 3678 3709 3709 3705 3702 3702>,
				<3565 3640 3666 3676 3676 3676 3676>,
				<3544 3620 3647 3661 3659 3659 3659>,
				<3522 3600 3628 3646 3640 3640 3640>,
				<3500 3580 3609 3631 3624 3624 3624>,
				<3478 3561 3589 3615 3606 3606 3606>,
				<3457 3541 3570 3600 3589 3589 3589>,
				<3444 3489 3462 3480 3471 3471 3471>,
				<3432 3437 3354 3360 3353 3353 3353>,
				<3419 3385 3246 3240 3235 3235 3235>,
				<3407 3334 3137 3120 3118 3118 3118>,
				<3395 3282 3029 3000 3000 3000 3000>;
	};

	qcom,rbatt-sf-lut {
		qcom,lut-col-legend = <(-20) (-10) 0 10 20 30 40>;
		qcom,lut-row-legend = <100 95 90 85 80 75 70 65 60 55 50 45 40 35 30 25 20 15 10>;
		qcom,lut-data = <218 161 146 123 47 24 24>,
				<218 161 146 123 47 24 24>,
				<218 161 146 123 47 24 24>,
				<218 161 146 123 47 24 24>,
				<218 161 146 123 47 24 24>,
				<218 161 146 123 47 24 24>,
				<218 161 146 123 47 24 24>,
				<218 161 146 123 47 24 24>,
				<218 161 146 123 47 24 24>,
				<218 161 146 123 47 24 24>,
				<218 161 146 123 47 24 24>,
				<218 161 146 123 47 24 24>,
				<218 161 146 123 47 24 24>,
				<218 161 146 123 47 24 24>,
				<218 161 146 123 47 24 24>,
				<218 161 146 123 47 24 24>,
				<218 161 146 123 47 24 24>,
				<218 161 146 123 47 24 24>,
				<218 161 146 123 47 24 24>;
		};
	};
