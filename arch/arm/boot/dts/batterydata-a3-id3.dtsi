qcom,A3-id3-batterydata {
	qcom,fcc-mah = <2040>;
	qcom,default-rbatt-mohm = <180>;
	qcom,rbatt-capacitive-mohm = <0>;
	qcom,flat-ocv-threshold-uv = <3800000>;
	qcom,max-voltage-uv = <4300000>;
	qcom,v-cutoff-uv = <3000000>;
	qcom,chg-term-ua = <204000>;
	qcom,batt-id-kohm = <47>;
	htc,capacity = <2040>;
	htc,batt_id = <3>;
	htc,id_raw_min = <510>;
	htc,id_raw_max = <630>;
	htc,type = <1>;
	htc,model_name = "BM35100";

	qcom,fcc-temp-lut {
		qcom,lut-col-legend = <(-20) (-10) 0 10 20 30 40>;
		qcom,lut-data = <2070 2080 2100 2100 2100>;
	};

	qcom,pc-temp-ocv-lut {
		qcom,lut-col-legend = <(-20) (-10) 0 10 20 30 40>;
		qcom,lut-row-legend = <100 95 90 85 80 75 70 65 60 55 50 45 40 35 30 25 20 15 10 9 8 7 6 5 4 3 2 1 0>;
		qcom,lut-data = <4250 4250 4250 4250 4250 4250 4250>,
				<4200 4200 4207 4209 4209 4208 4207>,
				<4142 4142 4152 4156 4156 4155 4154>,
				<4094 4094 4102 4106 4107 4106 4105>,
				<4038 4038 4054 4061 4062 4062 4060>,
				<3981 3981 3998 4008 4013 4015 4015>,
				<3939 3939 3952 3961 3970 3976 3977>,
				<3904 3904 3916 3923 3930 3937 3940>,
				<3870 3870 3881 3887 3893 3898 3901>,
				<3842 3842 3852 3857 3861 3863 3863>,
				<3818 3818 3828 3832 3835 3836 3736>,
				<3807 3807 3807 3811 3814 3815 3815>,
				<3789 3789 3789 3794 3797 3799 3799>,
				<3780 3780 3780 3780 3783 3785 3785>,
				<3769 3769 3769 3769 3771 3771 3772>,
				<3756 3756 3756 3756 3755 3750 3744>,
				<3738 3738 3738 3738 3736 3732 3726>,
				<3710 3710 3710 3710 3711 3707 3701>,
				<3673 3673 3673 3673 3678 3678 3673>,
				<3661 3661 3661 3661 3669 3668 3663>,
				<3650 3650 3650 3650 3659 3658 3653>,
				<3639 3639 3639 3639 3649 3649 3642>,
				<3628 3628 3628 3628 3639 3639 3632>,
				<3616 3616 3616 3616 3629 3629 3621>,
				<3521 3521 3521 3521 3540 3543 3533>,
				<3426 3426 3426 3426 3452 3456 3445>,
				<3332 3332 3332 3332 3363 3370 3357>,
				<3237 3237 3237 3237 3274 3283 3270>,
				<3200 3200 3200 3200 3200 3200 3200>;
	};

	qcom,rbatt-sf-lut {
		qcom,lut-col-legend = <(-20) (-10) 0 10 20 30 40>;
		qcom,lut-row-legend = <100 95 90 85 80 75 70 65 60 55 50 45 40 35 30 25 20 15 10>;
		qcom,lut-data = <348 257 168 168 168>,
				<348 257 168 168 168>,
				<348 257 168 168 168>,
				<348 257 168 168 168>,
				<348 257 168 168 168>,
				<348 257 168 168 168>,
				<348 257 168 168 168>,
				<348 257 168 168 168>,
				<348 257 168 168 168>,
				<348 257 168 168 168>,
				<348 257 168 168 168>,
				<348 257 168 168 168>,
				<348 257 168 168 168>,
				<348 257 168 168 168>,
				<348 257 168 168 168>,
				<348 257 168 168 168>,
				<348 257 168 168 168>,
				<348 257 168 168 168>,
				<348 257 168 168 168>;
	};
};
